/*
okay let's see if we can understand the using the api espressif provides via
their website recall that the esp chip itself is the ESP32-D0WD-V3 and on the
DOIT ESP32 DEVKIT V1 board


    *   *   *   *   *   *   *   *   *   *   *   *   *   *   *   *   *   *   * *
*   *   * Motor Control Pulse Width Modulator(MCPWM)
    *   *   *   *   *   *   *   *   *   *   *   *   *   *   *   *   *   *   * *
*   *   * The MCPWM peripheral is a versatile PWM generator, which contains
various submodules to make it a key element in power electronic applications
like motor control, digital power, and so on... iT CAN provide six PWM outputs
that can be set up to operate in several topologies. One common topology uses a
pair of PWM outputs driving a H-bridge to control motor rotation speed and
rotation direction. The timing and control resources inside are allocated into
two major types of submodules -PWM Timers and PWM Operators Each PWM timer
provides timing references that can either run freely or be synced to other
timers or external sources. Each PWM operator has all necessary control
resources to generate waveform pairs for one PWM channel. The MCPWM peripheral
also contains a dedicated capture submodule that is used in systems where
accurate timing of external events is important ESP32 contains two MCPWM
peripherals: MCPWM0 & MCPWM1. Their control registers are located in 4kB memory
blocks starting at memory locations 0x3FF5E000 and 0x3FF6C000 respectively

[Overview]
    --PWM Timers 0,1 and 2
    --Every PWM timer has a dedicated 8-bit clock prescaler
    --The 16-bit counter in the PWM timer can work in count-up mode, count-down
mode or count-up-down mode
    --A hardware sync can trigger a reload on the PWM timer with a phase
register. It will also trigger the prescaler's restart, so that the timer's
clock can also be synced. The source of the sync can come from any GPIO or any
    other PWM timer's sync_out

    --PWM Operators 0, 1 and 2
    --Every PWM operator has two PWM outputs: PWMxA and PWMxB. They can work
independently, in symmetric and asymmetric configuration
    --Software, asychronous override control of PWM signals
    --Configurable dead-time on rising and falling edges; each setup
independetly
    --All events can trigger CPU interrupts
    --Modulating of PWM output by high-frequency carrier signals, useful when
gate drives are insulated with a transformer.
    --Period, time stamps and important control register have shadow registers
with flexible updating methods


    --Fault Detection Module
    --Programmable fault handling allocated on fault condition in both
cycle-by-cycle mode and one-shot mode
    --A fault condition can force the PWM output to either high or low logic
levels

    --Capture module
    --Speed measurement of rotating machinery
    --Measurement of elapsed time between position sensor pulses
    --Period and duty-cycle measurement of pulse train signals
    --Decoding current or voltage amplitude derived from duty-cycle encoded
signals from current/voltage sensors
    --Three individual capture channels, each of which has a time-stamp register
32 bits
    --Selection of edge polarity and prescaling of input capture signal
    --The capture timer can sync with a PWM timer or external signals
    --Interrupt on each of the three capture channels



[Features]
Each MCPWM peripheral has one clock divider(prescaler), three PWM timers, three
PWM operators, and a capture module. PWM timers are used for generating timing
references to produce related PWM signals. PWM operators can also use different
PWM timer values to produce the PWM signals that work alone. Different PWM
operators can also use different PWM timer values to produce the PWM signals
that work alone. Different PWM timers can also be synced together.


Typically, the MCPWM peripheral can be used in the following scenarios...
    ---Digital motor control, e.g brushed/brushless DC motor, RC servo motor
    ---Switch mode-based digital power conversion
    ---Power DAC, where the duty cycle is eq. to a DAC analog value
    ---Calculate external pulse width, and convert it into other analog values
like speed, distance
    ---Generate Space Vector PWM (SVPWM) signals for Field Oriented Control
(FOC)

The main submodules being the
    --1.MCPWM SYnc{module focused on synchronizing the MCPWM timers, so that the
final PWM signals generated by different MCPWM generators can have a fixed phase
difference}  : Sync GPIO---Timer Sync goes into.....MCPWM Timer
    --2.MCPWM Capture{submodule that can work even without the above MCPWM
operators. The capture consists one dedicated timer and several independent
channels, with each channel connected to the GPIO. A pulse on the GPIO triggers
the capture timer to store the time-base count value and then notify you by an
interrupt. Using this feature, you can measure a pulse width precisely} : MCPWM
Capture Timer--MCPWM Capture Channel
    --3.MCPWM Operators{They key module that is responsibleb for generating the
PWM waveforms. It consists of other submodules, like comparator, PWM generator,
dead time, and carrier modulator}: MCPWM Comparators---MCPWM Generators---Dead
time---Carrier Modulation---Brake(this can be read from a FAULT GPIO pin on your
esp) goes outo.....
    --4.PWM Channels: PWM_A, PWM_B, etc....



[Resource Allocation and Initialization]
As displayed in the diagram above(sort of), the MCPWM peripheral consists of
several submodules. Each submodule has its own resource allocation... [MCPWM
Timers] You can allocate a MCPWM timer object by calling mcpwm_new_timer()


Now for ESC calibration this website recommends using this conventional standard
to aid in your PWM settings for the ESC [ESC/Throttle Mode] 1.Run ESC
calibration on your hardware first to determine its min/max pulse range 2.Enter
those calibrated values(typically 1000-2000us) and the control frequency
(typically 50Hz) 3.Set throttle percentage to verify the pulse width at each
operating point 4.Use Pulse width to verify against an oscillopscope or logic
analyzer during debugging
*/
#include <stdio.h>
// #include "driver/mcpwm.h"
#include "driver/gpio.h"
#include "driver/mcpwm_cmpr.h"
#include "driver/mcpwm_gen.h"
#include "driver/mcpwm_oper.h"
#include "driver/mcpwm_timer.h"
#include "esp_log.h"
#include "freertos/task.h"
#include "freertos/FreeRTOS.h"
static const char *TAG = "PWM-TAG";

// setting up the PWM module
mcpwm_timer_config_t pwm_timer_config = {
    .clk_src =
        MCPWM_TIMER_CLK_SRC_DEFAULT, // i believe this might be 160MHz!!!{based
                                     // off the comments left behind the in the
                                     // source file}
    .count_mode = MCPWM_TIMER_COUNT_MODE_UP,
    .resolution_hz =
        1000000,        // espressif has code that converts the 160MHz to 1Mhz
    .intr_priority = 0, // once configured hardware module does the rest....
    .group_id = 0, // i wanna say this based off of operator and timer 0....
    .period_ticks =
        20000, // we are calibrating foran ESC!!! conventional PWMs are 1000us,
               // 1500us, 2000us...however not too sure on the duty cycle

};

// setting up the MCPWM operator using group id = 0
mcpwm_operator_config_t pwm_op_config = {
    // just note that this is the setup NOT the operational code!
    .group_id = 0,
    .intr_priority = 0,
    //.flags = ???? seems like the driver handles this????
};

// setting up the MCPWM comparators for Pulse Widths for a given frequency(in
// our case 50Hz operational PWM signal)
mcpwm_comparator_config_t pwm_cmpr_config = {
    // just note that this is the setup NOT the operational code!
    .intr_priority = 0,
    //.flags = ???? seems like the dirver handles this......need to investigate
    //this more
};

// setting up the MCPWM generator for the GPIO output!
mcpwm_generator_config_t pwm_gen_config = {
    .gen_gpio_num = GPIO_NUM_18, // double check with the DOIT ESP32 DEVKIT V1
                                 // module pinout!!
    //.flags......
};

void app_main(void) {

  // 1.
  // Creating the PWM-Timer Module
  mcpwm_timer_handle_t esp_timer_handle_stuff; // not sure what this does!
  esp_err_t setup_pwm_timer_error =
      mcpwm_new_timer(&pwm_timer_config, &esp_timer_handle_stuff);
  if (setup_pwm_timer_error == ESP_OK) {
    ESP_LOGI(TAG, "PWM Timer creation went just fine!");
  } else {
    ESP_LOGE(TAG, "Error: %s", esp_err_to_name(setup_pwm_timer_error));
  }
  //************************************ */

  // 2.
  // Creating the PWM-Operator Module
  mcpwm_oper_handle_t esp_operator_handle_stuff;
  esp_err_t setup_operator_pwm_error =
      mcpwm_new_operator(&pwm_op_config, &esp_operator_handle_stuff);
  if (setup_operator_pwm_error == ESP_OK) {
    ESP_LOGI(TAG, "PWM Operator Creation went just fine!");
  } else {
    ESP_LOGE(TAG, "Error:%s", esp_err_to_name(setup_pwm_timer_error));
  }
  // Connecting the operator and the timer together..
  esp_err_t operator_connect_timer_error = mcpwm_operator_connect_timer(
      esp_operator_handle_stuff, esp_timer_handle_stuff);
  if (operator_connect_timer_error == ESP_OK) {
    ESP_LOGI(TAG, "Operator and Timer Connected!");
  } else {
    ESP_LOGE(TAG, "Error: %s", esp_err_to_name(operator_connect_timer_error));
  }
  //************************************ */

  // 3.
  // Creating the PWM-Comparator Module
  mcpwm_cmpr_handle_t esp_comparator_handle_stuff;
  esp_err_t setup_comparator_error =
      mcpwm_new_comparator(esp_operator_handle_stuff, &pwm_cmpr_config,
                           &esp_comparator_handle_stuff);
  if (setup_comparator_error == ESP_OK) {
    ESP_LOGI(TAG, "Comparator all setup!");
  } else {
    ESP_LOGE(TAG, "Error:%s", esp_err_to_name(setup_comparator_error));
  }
  // Setting the comapartor value(so given a frequency of 50Hz we can choose
  // duty cycles based off of this frequency say for instance the 1000us duty
  // cycle with respect to 20ms)
  esp_err_t setting_compare_value_error = mcpwm_comparator_set_compare_value(
      esp_comparator_handle_stuff,
      1000); // we set the resolution clock to be 1MHz~=1us so tha 1000 times
             // should be the tick....
  if (setting_compare_value_error == ESP_OK) {
    ESP_LOGI(TAG, "Compare Value All setup!");
  } else {
    ESP_LOGE(TAG, "Error:%s", esp_err_to_name(setting_compare_value_error));
  }

  //************************************ */

  // 4.
  // Creating the generator for our GPIO
  mcpwm_gen_compare_event_action_t pwm_gen_cmpr_config = {
      .direction = MCPWM_TIMER_DIRECTION_UP, // like counting up???
      .comparator = esp_comparator_handle_stuff,
      .action = MCPWM_GEN_ACTION_LOW, // maybe??
  };
  mcpwm_gen_handle_t esp_generator_handle_stuff;
  esp_err_t creating_gen_error = mcpwm_new_generator(
      esp_operator_handle_stuff, &pwm_gen_config, &esp_generator_handle_stuff);
  if (creating_gen_error == ESP_OK) {
    ESP_LOGI(TAG, "Generator Created!");
  } else {
    ESP_LOGE(TAG, "Error:%s", esp_err_to_name(creating_gen_error));
  }
  // setting the actio event based on the timer value...basically when it
  // starts!
  ESP_ERROR_CHECK(mcpwm_generator_set_action_on_timer_event(
      esp_generator_handle_stuff,
      MCPWM_GEN_TIMER_EVENT_ACTION(MCPWM_TIMER_DIRECTION_UP,
                                   MCPWM_TIMER_EVENT_EMPTY,
                                   MCPWM_GEN_ACTION_HIGH)));
  // setting the action event based on the comapator
  esp_err_t force_event_compare_error =
      mcpwm_generator_set_action_on_compare_event(esp_generator_handle_stuff,
                                                  pwm_gen_cmpr_config);
  if (force_event_compare_error == ESP_OK) {
    ESP_LOGI(TAG, "Comparator Event Set!...Toggled?");
  } else {
    ESP_LOGE(TAG, "Error:%s", esp_err_to_name(force_event_compare_error));
  }

  //so initially on timer value its high....then compare value comes in the way and then sets the pwm signal to low
  //then the process repeats again once the 20ms period has been counted
  //************************************* */
  ESP_ERROR_CHECK(mcpwm_timer_enable(esp_timer_handle_stuff));
  ESP_ERROR_CHECK(mcpwm_timer_start_stop(esp_timer_handle_stuff,MCPWM_TIMER_START_NO_STOP));
  // infinite loop
  while (1) {
    vTaskDelay(pdMS_TO_TICKS(1000));
}
}